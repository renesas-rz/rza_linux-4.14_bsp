## patches-buildroot/buildroot-2017.02/rza1_defconfig
```kconfig
BR2_arm=y
BR2_cortex_a9=y
BR2_ARM_ENABLE_NEON=y
BR2_ARM_ENABLE_VFP=y
BR2_ARM_FPU_VFPV3=y
BR2_TOOLCHAIN_EXTERNAL=y
BR2_TARGET_GENERIC_GETTY_PORT="ttySC0"
BR2_ROOTFS_OVERLAY="$(BASE_DIR)/rootfs_overlay"
BR2_PACKAGE_FBV=y
# BR2_PACKAGE_FBV_GIF is not set
BR2_PACKAGE_TSLIB=y
BR2_PACKAGE_LIBCURL=y
BR2_PACKAGE_CURL=y
BR2_PACKAGE_LRZSZ=y
BR2_TARGET_ROOTFS_AXFS=y
```
